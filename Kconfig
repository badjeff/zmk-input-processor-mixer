## Kconfig
```kconfig
# Copyright (c) 2025 The ZMK Contributors
# SPDX-License-Identifier: MIT

rsource "src/pointing/Kconfig"
```

## dts/bindings/input_processors/zmk,input-processor-mixer.yaml
```yaml
# Copyright (c) 2024, The ZMK Contributors
# SPDX-License-Identifier: MIT

description: Input Processor for mixing values after input events

compatible: "zmk,input-processor-mixer"

include: ip_one_param.yaml
```
